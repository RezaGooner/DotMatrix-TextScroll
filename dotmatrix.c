#include <mega32.h>
#include <delay.h>


unsigned char continuous_text[] = {
    0x00, 0xFF, 0xFF, 0x1B, 0x3B, 0x6F, 0xCE, 0x80, 
    0x00, 0xFF, 0xFF, 0xDB, 0xDB, 0xDB, 0xDB, 0x00,
    0x00, 0xE3, 0xF3, 0xDB, 0xCF, 0xC7, 0xC7, 0x00,
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    0x00, 0xFF, 0xFF, 0x1B, 0x3B, 0x6F, 0xCE, 0x80
};

#define TOTAL_COLUMNS (sizeof(continuous_text)/sizeof(continuous_text[0]))

void send_to_matrix(unsigned char column, unsigned char row_data) {
    PORTA = column;
    PORTB = row_data;
    delay_us(500);
}

void scroll_continuous_text() {
    int start_col, i, j;
    

    for (start_col = 0; start_col < TOTAL_COLUMNS + 8; start_col++) {
        for (j = 0; j < 10; j++) {
            for (i = 0; i < 8; i++) { 
                int text_col = start_col - i;
                unsigned char col_data = (text_col >= 0 && text_col < TOTAL_COLUMNS) ? continuous_text[text_col] : 0x00;
                send_to_matrix(~(1 << i), col_data);
            }
        }
    }
}

void main(void) {
    DDRA = 0xFF;
    DDRB = 0xFF;

    while (1) {
        scroll_continuous_text();
        delay_ms(500);
    }
}